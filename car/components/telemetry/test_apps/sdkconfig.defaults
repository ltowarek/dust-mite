## car/components/telemetry/test_apps/sdkconfig.defaults
```kconfig
CONFIG_IDF_TARGET="esp32s3"
CONFIG_FREERTOS_HZ=1000
CONFIG_ESP_TASK_WDT_EN=n
CONFIG_FREERTOS_TASK_NOTIFICATION_ARRAY_ENTRIES=3
```

## car/components/telemetry/test_apps/sdkconfig.defaults.coverage
```kconfig
CONFIG_TELEMETRY_TEST_COVERAGE=y
CONFIG_ESP_TRACE_TRANSPORT_APPTRACE=y
CONFIG_APPTRACE_DEST_JTAG=y
CONFIG_ESP_GCOV_ENABLE=y
```

## car/sdkconfig.defaults.all
```kconfig
# Overlay that enables every off-by-default feature flag. Used by CI to catch
# conditional-compilation bit rot in #ifdef branches not exercised by
# car/sdkconfig.defaults, and usable standalone for hardware debugging (e.g.
# issue #43's task-stats/heap metrics) without hand-editing sdkconfig.defaults.
CONFIG_ESP_OPENTELEMETRY_METRICS_TASK_STATS_ENABLED=y
CONFIG_ESP_OPENTELEMETRY_METRICS_LARGEST_FREE_BLOCK_ENABLED=y
```

## car/test/sdkconfig.defaults
```kconfig
CONFIG_ESP_TASK_WDT_EN=n

CONFIG_IDF_TARGET="esp32s3"

CONFIG_FREERTOS_HZ=1000
CONFIG_FREERTOS_TASK_NOTIFICATION_ARRAY_ENTRIES=3
CONFIG_ESPTOOLPY_FLASHFREQ_80M=y
CONFIG_ESPTOOLPY_FLASHMODE_QIO=y

CONFIG_SPIRAM=y
CONFIG_SPIRAM_SPEED_80M=y
CONFIG_SPIRAM_MODE_OCT=y

CONFIG_HTTPD_WS_SUPPORT=y
CONFIG_HTTPD_WS_POST_HANDSHAKE_CB_SUPPORT=y
```
