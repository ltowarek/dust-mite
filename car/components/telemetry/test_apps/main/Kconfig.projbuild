## car/components/telemetry/test_apps/main/Kconfig.projbuild
```kconfig
menu "Telemetry test configuration"

config TELEMETRY_TEST_QEMU_MODE
    bool "Skip hardware peripheral init (QEMU mode)"
    default n
    help
        When enabled, skips I2C bus and sensor initialization so the test
        binary runs under QEMU. Hardware-dependent test cases report
        TEST_IGNORE instead of crashing on missing peripherals.

config TELEMETRY_TEST_UBSAN
    bool "Build telemetry with UndefinedBehaviorSanitizer"
    default n
    help
        Compiles the telemetry component under test with -fsanitize=undefined.
        Opt-in: not part of the default build, only enabled by the dedicated
        UBSan CI job/sdkconfig overlay.

config TELEMETRY_TEST_COVERAGE
    bool "Build telemetry with GCC coverage instrumentation"
    default n
    help
        Compiles the telemetry component under test with --coverage.  After
        each test case, tearDown calls esp_gcov_dump() which streams .gcda
        data to the host via the AppTrace JTAG protocol.  The patched esp-qemu
        emulates the AppTrace host and writes .gcda files directly to the
        build directory, adding to the counts of earlier dumps.  Opt-in:
        only enabled by the dedicated coverage CI job/sdkconfig overlay.

endmenu
```

## car/components/tracing/Kconfig.projbuild
```kconfig
menu "System metrics"
    config SYSTEM_METRICS_TASK_STATS_ENABLED
        bool "Enable per-task CPU usage / priority / stack metrics (debug only)"
        depends on ESP_OPENTELEMETRY_METRICS_ENABLED
        default n
        help
            Collects dust_mite_task_cpu_usage, dust_mite_task_priority and
            dust_mite_task_stack_min_free_bytes via FreeRTOS
            uxTaskGetSystemState(). FreeRTOS documents this whole API
            family as debug-only, not for production use. On a dual-core
            ESP-IDF build it holds the kernel lock, with interrupts masked,
            while it walks every task and scans its stack for the high-water
            mark, so interrupts on both cores wait for each refresh - leave
            disabled unless actively debugging task scheduling/CPU usage.

    config SYSTEM_METRICS_TASK_STATS_REFRESH_MS
        int "Task stats refresh interval (ms)"
        depends on SYSTEM_METRICS_TASK_STATS_ENABLED
        range 100 3600000
        default 10000
        help
            How often the task stats are read again. Collections in between
            report the last read, so a short interval gives finer CPU usage
            and masks interrupts more often.

    config SYSTEM_METRICS_LARGEST_FREE_BLOCK_ENABLED
        bool "Enable largest free heap block metric (debug only)"
        depends on ESP_OPENTELEMETRY_METRICS_ENABLED
        default n
        help
            Collects dust_mite_largest_free_block_bytes via
            heap_caps_get_largest_free_block(MALLOC_CAP_8BIT), which walks
            every allocated and free block (via tlsf_walk_pool()) under a
            heap lock, for both the internal SRAM heap and the PSRAM heap.
            The PSRAM walk requires real SPI reads of PSRAM-resident TLSF
            metadata, which competes with the camera's own PSRAM DMA traffic
            at the hardware bus level - independent of CPU core or task
            priority. On this board it disrupts the camera's real-time JPEG
            frame capture during streaming (issue #43) - leave disabled
            unless actively debugging heap fragmentation, and disable again
            afterward.
endmenu
```

## car/components/web_server/test_apps/main/Kconfig.projbuild
```kconfig
menu "Web server test configuration"

config WEB_SERVER_TEST_QEMU_MODE
    bool "Run the web server on QEMU's emulated Ethernet (QEMU mode)"
    default n
    help
        When enabled, skips the motor, tracing, Wi-Fi, camera and telemetry
        setup, brings the network up on QEMU's OpenCores Ethernet MAC instead,
        and feeds the web server synthetic camera frames and telemetry
        packets, so the WebSocket tests run against the real server in QEMU.

config WEB_SERVER_TEST_UBSAN
    bool "Build web_server with UndefinedBehaviorSanitizer"
    default n
    help
        Compiles the web_server component under test with -fsanitize=undefined.
        Opt-in: not part of the default build, only enabled by the dedicated
        UBSan CI job/sdkconfig overlay.

config WEB_SERVER_TEST_COVERAGE
    bool "Build web_server with GCC coverage instrumentation"
    default n
    help
        Compiles the web_server component under test with --coverage.  After
        each test case, tearDown calls esp_gcov_dump() which streams .gcda
        data to the host via the AppTrace JTAG protocol.  The patched esp-qemu
        emulates the AppTrace host and writes .gcda files directly to the
        build directory, adding to the counts of earlier boots.  Opt-in:
        only enabled by the dedicated coverage CI job/sdkconfig overlay.

endmenu
```
